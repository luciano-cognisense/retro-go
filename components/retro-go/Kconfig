## components/retro-go/Kconfig
```kconfig
menu "Retro-Go"
    config RG_DISPLAY_ACTIVITY
        bool "Track display task activity (rg_display_is_active)"
        default n
        help
            Adds rg_display_is_active(): true from rg_display_submit() until
            the display task has finished that frame, lcd_sync() included
            (rg_display_is_busy() keeps reporting only a non-empty queue).
            Costs one increment per submitted frame and one store per
            displayed frame. Off by default; an application that needs it
            selects it (gbsp's hybrid render does).
    config RG_AUDIO_I2S_TELEMETRY
        bool "Measure I2S DMA queue behaviour"
        default n
        help
            Diagnostic-only counters for the legacy I2S driver: completed and
            replayed DMA buffers, frames accepted, time spent specifically in
            i2s_write(), event backlog and sample-rate reset epochs. Off by
            default; applications that need transition traces select it.
    config RG_AUDIO_I2S_LIVE_RATE
        bool "Update the ESP32-S3 external-I2S clock without restarting DMA"
        default n
        depends on IDF_TARGET_ESP32S3
        help
            Updates only the TX clock divider for the external stereo 16-bit
            I2S path. The legacy i2s_set_sample_rates() implementation stops
            and restarts the channel even when the DMA layout is unchanged;
            this option preserves the queued descriptors across rate changes.
            Applications must opt in. Other audio devices retain the legacy
            driver operation.
    config RG_AUDIO_I2S_AUTO_CLEAR
        bool "Clear empty I2S TX DMA descriptors to silence"
        default n
        help
            Enables the legacy driver's tx_desc_auto_clear option. When the
            producer cannot refill a TX descriptor in time, the completed
            descriptor is cleared instead of replaying stale samples. This
            replaces the repeated-buffer buzz with digital silence. Apps must
            opt in; the default behaviour of every other core is unchanged.
endmenu
```

## gbsp/components/gbsp-libretro/Kconfig
```kconfig
menu "gpSP experiments"
    config GBSP_FAST_RAM_WRITES
        bool "Direct interpreter writes to IWRAM/EWRAM"
        default n
        help
            Experimental fast path for ordinary work RAM stores only.
            Keeps original cycle accounting and all non-RAM handlers.
            Ignored with dynarec/SMC. Compare on hardware before adopting.
    config GBSP_MEMORY_PROFILE
        bool "Count interpreter data accesses (diagnostic only)"
        default n
        help
            Count interpreter data reads/writes by region and width.
            Excludes instruction fetch, DMA, PPU and addresses >= 0x10000000.
            Writes window totals to gbsp-memory.txt. Adds hot-path overhead;
            do not compare its timings with normal builds. Ignored with dynarec.
    config GBSP_COMPACT_READS
        bool "Share range check in interpreter scalar reads"
        default n
        help
            Experimental scalar load layout. Preserves original handlers,
            signed loads and timing. Compare against mapped RAM stores alone.
    config GBSP_CPSR_CONSUMER_SYNC
        bool "Sync CPSR flags at the sites that read them"
        default n
        help
            Adds collapse_flags() to MSR and to BX ARM->Thumb, the only two
            sites that need it and do not already do it. Idempotent while the
            per-instruction sync is still in place, so this alone must not
            change behaviour. Enable it first, and confirm that, before
            enabling the lazy dispatch below. Ignored with dynarec.
    config GBSP_CPSR_LAZY_DISPATCH
        bool "Drop the per-instruction CPSR flag sync"
        default n
        select GBSP_CPSR_CONSUMER_SYNC
        help
            Removes collapse_flags() from the top of arm_loop/thumb_loop, so
            the flag cache in reg[CPSR] is refreshed only by the consumers.
            14 Xtensa instructions per interpreted instruction; whether that
            becomes speed is a hardware question. Ignored with dynarec.
    config GBSP_SPARSE_REGISTERS
        bool "Iterate selected registers in block transfers"
        default n
        help
            Experimental ARM/Thumb register-list iteration using ctz.
            Keeps transfer order, addresses, handlers and writeback unchanged.
    config GBSP_FETCH_PC
        bool "Reuse PC within an instruction fetch"
        default n
        help
            Experimental ARM/Thumb fetch layout. Preserves slow-path reload,
            mapping, opcode reads and cycles. Ignored with dynarec.
    config GBSP_NO_CHEAT_HOOK
        bool "Remove the per-instruction cheat-hook test (Candidato A, passo 2)"
        default n
        help
            Drops the cheat_master_hook snapshot and the PC==hook comparison
            from the top of arm_loop/thumb_loop entirely (2 Xtensa
            instructions per interpreted instruction on top of the snapshot
            already taken unconditionally). cheat_parse() then refuses every
            code with CheatErrorNotSupported instead of accepting one that
            can never fire. Turn this off again before wiring up any cheat
            UI. Host-diff verified; never measured on hardware in isolation.
    config GBSP_CPU_RODATA_DRAM
        bool "Place cpu.cpp read-only data (dispatch tables) in internal DRAM"
        default n
        help
            Maps the .rodata of cpu.cpp (the jump tables used by the ARM
            condition/opcode and Thumb opcode dispatch in execute_arm, plus
            bit_count, cpu_modes and PSR masks, ~3KB) to internal DRAM
            instead of flash-mapped rodata, which shares the data cache
            with PSRAM. Instructions are unchanged; only table addresses
            move. Costs internal DRAM. Never measured on hardware.
    config GBSP_RENDER_CORE1
        bool "Render scanlines on core 1 (experimental)"
        default n
        help
            Hands each visible scanline to a worker task pinned to core 1,
            below rg_display/rg_input, while core 0 keeps emulating. At most
            one job is pending; it renders from a copy of the video I/O
            registers, and every other writer of VRAM, OAM, palette or the
            renderer's own state waits for it first. Falls back to the
            synchronous path if the task cannot be created. Prototype: not
            measured on hardware.
    config GBSP_RENDER_CORE1_HYBRID
        bool "Render on core 0 while the display task is active"
        depends on GBSP_RENDER_CORE1
        default n
        select RG_DISPLAY_ACTIVITY
        help
            While rg_display_is_active() reports that the display task may
            still be using core 1 for the previous frame (queued, in
            write_update() or in lcd_sync()), scanlines are rendered on
            core 0 after draining any pending job; only afterwards are they
            handed to the core 1 worker. The worker keeps its priority below
            the display. Prototype: not measured on hardware.
    config GBSP_RENDER_CORE1_ADAPTIVE
        bool "Per-frame adaptive choice between the worker and core 0"
        depends on GBSP_RENDER_CORE1_HYBRID
        default n
        help
            Measures, within each frame and in core 0 cycles per line, what
            rendering on core 0 costs (lines rendered while the display was
            active) and what handing a line to the worker costs core 0
            (submit plus every wait paid while that job was pending). After
            4 synchronous lines and 8 settled jobs, if the worker costs at
            least 7/8 of rendering here, the pending job is drained and the
            rest of the frame renders on core 0. Starts over every frame.
            Prototype: not measured on hardware.
    config GBSP_RENDER_CORE1_STATS
        bool "Count render worker jobs, waits and busy time"
        depends on GBSP_RENDER_CORE1
        default n
        help
            Adds a render_core1 line to the profile log. Diagnostic only.
    config GBSP_CPU_ALERT_PER_INSTRUCTION
        bool "Reset cpu_alert at the start of every interpreted instruction"
        default n
        help
            execute_arm() keeps cpu_alert alive across instructions, so the
            compiler holds it in a stack slot and reloads it for the HALT/IRQ
            test at the end of every instruction. Only the instruction that
            set it can make that test fire (no handler that sets it jumps back
            to a loop head without the test), so resetting it at each ARM and
            Thumb loop head is equivalent and lets the compiler drop the test
            and the slot on every path that cannot set it. Measured on the
            target hardware with performance profile v4 (frame 112 -> 96 B,
            IRAM -1924 B; emu time lower in both games tested). Enabled only
            by that profile.
    config GBSP_THUMB_RESIDENT_PC
        bool "Keep the Thumb PC in a register across instructions"
        default n
        help
            In the Thumb loop of execute_arm() the PC is kept in a local
            variable that stays in a register from one instruction to the
            next. reg[REG_PC] is still written on every PC change (helpers and
            Rs = PC read it there), so only the PC loads go away. Thumb
            register indices are 0-7, so only explicit PC writes and the block
            transfer helpers change the PC; the copy is reloaded after those
            helpers and on every jump into the loop. The ARM loop is
            unchanged. Measured on the target hardware with performance
            profile v5 (IRAM +588 B, same frame; on a still scene Fire Red
            emu about -1%, Mario neutral). Enabled only by that profile.
    config GBSP_ROM_SECOND_CHANCE
        bool "Give recently executed ROM pages a second chance in the page cache"
        default n
        help
            The ROM page cache (gba_memory.c) is a circular FIFO that skips the
            pages marked sticky in the current frame: a hit does not reorder
            anything, so the most used code page is evicted in its turn when it
            did not run in that frame. With this option the sticky bits are ORed
            into a persistent reference bitmap (128 B) once per frame, before
            they are cleared; evict_gamepak_page() then sends a non-sticky page
            with its reference bit to the tail once, clearing the bit. The hit
            path and touch_gamepak_page() are unchanged. Replayed on host traces
            of Fire Red (6 MB cache): page faults and bytes read -45%, worst
            60-frame burst 18 -> 10 faults. Measured on the target hardware
            with performance profile v6 (oc 0, frameskip 0, Fire Red): page
            faults and ROM read time -40%, cost per fault unchanged (~58 ms);
            Mario fits the cache and has no faults. BSS +128 B, flash +88 B,
            IRAM unchanged. Enabled only by that profile.
    config GBSP_ROM_BOUNCE_READ
        bool "Read ROM pages through an internal DMA-capable buffer"
        default n
        help
            The ROM cache lives in PSRAM, and on the ESP32-S3 the SD/MMC layer
            cannot DMA into PSRAM: sdmmc_read_sectors() then splits every read
            into single 512-byte block commands. With this option the ROM file
            is read with read() into a buffer in internal RAM
            (GBSP_ROM_BOUNCE_KB) and copied to PSRAM, so each chunk is one
            multi-block command. Applies to page faults and to the initial
            load of the cache. Falls back to the stdio path when the buffer
            cannot be allocated. Measured on the target hardware with
            performance profile v8 (oc 0, frameskip 0, Fire Red): cost per page
            fault 58.3 -> 22.8 ms, boot load of the 6 MB cache 10.9 -> 4.3 s;
            execute_arm unchanged, 8 KB of internal RAM. Enabled only by
            performance profile v9.
    config GBSP_ROM_BOUNCE_KB
        int "ROM bounce buffer size (KB)"
        depends on GBSP_ROM_BOUNCE_READ
        range 1 32
        default 8
    config GBSP_AUDIO_CLOCK_COMP
        bool "Compensate the I2S clock for the retro-go overclock (ESP32-S3)"
        default n
        depends on IDF_TARGET_ESP32S3
        help
            The S3 I2S clock is PLL_F160M = BBPLL/3 and rg_system_set_overclock()
            raises the BBPLL, so under overclock the DAC consumes more samples
            than programmed (x280/240 at oc 2): emulation was held back only
            above ~117% and below that the ring underran. With this option the
            audio sync rate is the rate the DAC really consumes; the programmed
            rate is scaled by nominal/actual CPU clock, measured (CCOUNT against
            the crystal-fed systimer) once per overclock change. No effect at
            oc 0. Measured on hardware (oc 2): 32768Hz requested -> 28087Hz
            programmed, ~32768 samples/s consumed, at most 60fps sustained.
    config GBSP_WAITSTATE_COMMON_BASE
        bool "Store sequential and non-sequential waitstates behind one base"
        default n
        help
            Places ws_cyc_seq and ws_cyc_nseq in one contiguous object. On
            Thumb, GCC keeps the common base in a register across the dispatch
            tails. A 985-million-instruction hardware histogram predicts about
            1.15 fewer Xtensa instructions per Thumb instruction in Fire Red
            and 1.17 in Mario. ARM pays a small instruction/stack tradeoff, and
            the execute_arm frame grows from 96 to 112 bytes. Measured on the
            target hardware with performance profile v7 (oc 0, frameskip 0):
            stable CPU-side time fell 1.21% in Fire Red and 1.07% in Mario,
            with save/load and normal play working in both games. Enabled only
            by performance profile v8.
    config GBSP_AUDIO_TRANSITION_STATS
        bool "Audio transition and I2S DMA telemetry (diagnostic only)"
        default n
        select RG_AUDIO_I2S_TELEMETRY
        help
            Records each one-second audio-control decision together with exact
            I2S-driver deltas: accepted and completed frames, underrun replays,
            time spent in i2s_write(), event backlog and sample-rate reset
            epochs. Samples are buffered in RAM and written with the normal
            five-second profile window, so diagnosis does not add SD writes to
            the transition being measured. Does not change the rate policy.
    config GBSP_AUDIO_LIVE_RATE
        bool "Preserve the I2S DMA ring across audio-rate changes"
        default n
        depends on GBSP_AUDIO_CLOCK_COMP && IDF_TARGET_ESP32S3
        select RG_AUDIO_I2S_LIVE_RATE
        help
            Keeps the accepted K audio-control policy but applies its rate
            changes by updating the ESP32-S3 external-I2S TX clock divider in
            place. This avoids the stop/start performed by the legacy API and
            preserves the DMA descriptor position and queued audio. Measured
            on hardware: every rate change completed without a DMA restart,
            transition windows had fewer underruns and lower i2s_write time,
            and the sound was judged more natural. Other devices fall back to
            i2s_set_sample_rates().
endmenu
```
